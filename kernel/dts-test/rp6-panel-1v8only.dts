// SPDX-License-Identifier: BSD-3-Clause
/*
 * Bring-up test: the RP6 tree, but the panel is powered the way ROCKNIX does
 * it (only the 1.8 V rail, as vddio; the PMIC LDOs and the 2.8 V rail are left
 * as the bootloader set them). Same panel driver as the main entry.
 */
#include "qcom/qcs8550-retroidpocket-rp6.dts"

&{/soc@0/display-subsystem@ae00000/dsi@ae94000/panel@0} {
	/delete-property/ vdd-supply;
	/delete-property/ vci-supply;
	/delete-property/ vdd18-supply;
	/delete-property/ vdd28-supply;
	vddio-supply = <&vdd_disp_1v8>;
};
