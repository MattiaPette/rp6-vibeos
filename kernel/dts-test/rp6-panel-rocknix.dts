// SPDX-License-Identifier: BSD-3-Clause
/*
 * Bring-up test: as rp6-panel-1v8only, and driven by the ROCKNIX panel driver
 * (kernel/patches/0001), which sends the init sequence as generic writes.
 */
#include "rp6-panel-1v8only.dts"

&{/soc@0/display-subsystem@ae00000/dsi@ae94000/panel@0} {
	compatible = "vtdr6130,rp6";
};
